## Code/test_LSM/Kconfig
```kconfig
config SECURITY_TEST

     bool " TEST Kernel Support"
     depends on NETLABEL && SECURITY_NETWORK
     default n
     help
       This selects the Simplified Mandatory Access
Control Kernel.
       Smack is useful for sensitivity, integrity, and
a variety
       of other mandatory security schemes.
       If you are unsure how to answer this question,
answer N.

sourcesecurity/test/Kconfig
```
